## CMakeLists.txt
```
#
# Copyright (c) 2021 Nordic Semiconductor ASA
#
# SPDX-License-Identifier: LicenseRef-Nordic-5-Clause
#

cmake_minimum_required(VERSION 3.20.0)

set(DTC_OVERLAY_FILE "${CMAKE_CURRENT_SOURCE_DIR}/app.overlay" CACHE STRING "Application devicetree overlay" FORCE)

find_package(Zephyr HINTS $ENV{ZEPHYR_BASE})

project(matter-template)

# Enable GNU STD support and initialize the Matter Data Model.
include(${ZEPHYR_CONNECTEDHOMEIP_MODULE_DIR}/config/nrfconnect/app/enable-gnu-std.cmake)
include(${ZEPHYR_CONNECTEDHOMEIP_MODULE_DIR}/src/app/chip_data_model.cmake)

# NORDIC SDK APP START

# Include all source files that are located in the Matter common directory.
include(${ZEPHYR_NRF_MODULE_DIR}/samples/matter/common/cmake/source_common.cmake)

target_include_directories(app PRIVATE
    src
    ${CONFIG_NCS_SAMPLE_MATTER_ZAP_FILES_PATH}
)

target_sources(app PRIVATE
    src/app_task.cpp
    src/battery_monitor.cpp
    ${ZEPHYR_CONNECTEDHOMEIP_MODULE_DIR}/src/app/clusters/power-source-server/power-source-server.cpp
    src/main.cpp
    ${ZEPHYR_CONNECTEDHOMEIP_MODULE_DIR}/src/app/clusters/identify-server/identify-server.cpp
)

chip_configure_data_model(app
    INCLUDE_SERVER
    BYPASS_IDL
    GEN_DIR ${CONFIG_NCS_SAMPLE_MATTER_ZAP_FILES_PATH}/zap-generated
    ZAP_FILE ${CMAKE_CURRENT_SOURCE_DIR}/${CONFIG_NCS_SAMPLE_MATTER_ZAP_FILES_PATH}/template.zap
)
# NORDIC SDK APP END
```

## Kconfig.sysbuild
```
#
# Copyright (c) 2023 Nordic Semiconductor ASA
#
# SPDX-License-Identifier: LicenseRef-Nordic-5-Clause
#

config WIFI_NRF70
	default y if BOARD_NRF7002DK

#### Radio core selection
config NRF_DEFAULT_IPC_RADIO
	default y

# Enable IEEE802.15.4 serialization to network core
# This config automatically pulls in the `overlay-802154.conf` in the ipc_radio image
config NETCORE_IPC_RADIO_IEEE802154
	default y if SOC_SERIES_NRF53X && !WIFI_NRF70

# Enable Bluetooth serialization to network core
# This config automatically pulls in the `overlay-bt_hci_ipc.conf` in the ipc_radio image
config NETCORE_IPC_RADIO_BT_HCI_IPC
	default y if SOC_SERIES_NRF53X

#### Bootloader
choice BOOTLOADER
	default BOOTLOADER_MCUBOOT if !BOARD_NRF21540DK
endchoice

if BOOTLOADER_MCUBOOT

#### DFU multi-image support
config DFU_MULTI_IMAGE_PACKAGE_BUILD
	default y

config DFU_MULTI_IMAGE_PACKAGE_APP
	default y

# External flash is not used for MCUboot secondary on this board.
# Leave PM_EXTERNAL_FLASH_MCUBOOT_SECONDARY to the NCS definition;
# sysbuild_internal.conf explicitly keeps the secondary slot in internal RRAM.

#### DFU network core configuration
if SOC_SERIES_NRF53X

config MCUBOOT_UPDATEABLE_IMAGES
	default 2

choice MCUBOOT_MODE
	default MCUBOOT_MODE_OVERWRITE_ONLY
endchoice

choice BOOT_SIGNATURE_TYPE
	default BOOT_SIGNATURE_TYPE_RSA
endchoice

config SECURE_BOOT_NETCORE
	default y

config NETCORE_APP_UPDATE
	default y

config DFU_MULTI_IMAGE_PACKAGE_NET
	default y

endif # SOC_SERIES_NRF53X

if BOARD_NRF54L15DK

# Disable checking the external drivers for nRF54L15 DKs.
config PM_OVERRIDE_EXTERNAL_DRIVER_CHECK
	default y

# override the mcuboot pad size, because it is not set globally for NS build.
config PM_MCUBOOT_PAD
	default 0x800

endif # BOARD_NRF54L15DK

endif # BOOTLOADER_MCUBOOT

#### Enable generating factory data
config MATTER_FACTORY_DATA_GENERATE
	default y if !BOARD_NRF21540DK

source "share/sysbuild/Kconfig"
```

## prj.conf
```kconfig
#
# Copyright (c) 2021 Nordic Semiconductor ASA
#
# SPDX-License-Identifier: LicenseRef-Nordic-5-Clause
#

# This sample uses Kconfig.defaults to set options common for all
# samples. This file should contain only options specific for this sample
# or overrides of default values.

# Enable CHIP
CONFIG_CHIP=y
CONFIG_CHIP_PROJECT_CONFIG="src/chip_project_config.h"
# 32768 == 0x8000 (example Product ID added temporaly,
# but it must be changed with proper PID from the list:
# https://github.com/project-chip/connectedhomeip/blob/482e6fd03196a6de45465a90003947ef4b86e0b1/docs/examples/discussion/PID_allocation_for_example_apps.md)
CONFIG_CHIP_DEVICE_PRODUCT_ID=32768
CONFIG_STD_CPP17=y

# Enable Matter pairing automatically on application start.
CONFIG_CHIP_ENABLE_PAIRING_AUTOSTART=y

# Enable Matter extended announcement and increase duration to 1 hour.
CONFIG_CHIP_BLE_EXT_ADVERTISING=y
CONFIG_CHIP_BLE_ADVERTISING_DURATION=60

# Add support for LEDs and buttons on Nordic development kits
CONFIG_DK_LIBRARY=y

# Bluetooth Low Energy configuration
CONFIG_BT_DEVICE_NAME="MatterTemplate"

# Other settings
CONFIG_THREAD_NAME=y
CONFIG_MPU_STACK_GUARD=y
CONFIG_RESET_ON_FATAL_ERROR=n
CONFIG_CHIP_LIB_SHELL=y
CONFIG_NCS_SAMPLE_MATTER_TEST_SHELL=y

# Disable NFC commissioning
CONFIG_CHIP_NFC_COMMISSIONING=n

# Reduce application size
CONFIG_USE_SEGGER_RTT=n

# Enable Factory Data feature
CONFIG_CHIP_FACTORY_DATA=y
CONFIG_CHIP_FACTORY_DATA_BUILD=y


CONFIG_PM_PARTITION_SIZE_SETTINGS_STORAGE=0x4000

# Brievenbus: LSM6DS3TR-C accelerometer
CONFIG_I2C=y
CONFIG_SENSOR=y
CONFIG_LSM6DSL=y

CONFIG_GPIO=y

# XIAO battery voltage monitoring
CONFIG_ADC=y

# Matter Thread Sleepy End Device
CONFIG_CHIP_ENABLE_ICD_SUPPORT=y
```

## app.overlay
```dts
/ {
    zephyr,user {
        io-channels = <&adc 7>;
    };
};

/* Schakel de meetkring niet automatisch in bij het opstarten. */
&vbat_pwr {
    /delete-property/ regulator-boot-on;
};
```

## src/app_task.cpp
```c
/*
 * Copyright (c) 2021 Nordic Semiconductor ASA
 *
 * SPDX-License-Identifier: LicenseRef-Nordic-5-Clause
 */

#include "app_task.h"

#include "app/matter_init.h"
#include "app/task_executor.h"
#include "board/board.h"
#include "lib/core/CHIPError.h"
#include "lib/support/CodeUtils.h"

#include <setup_payload/OnboardingCodesUtil.h>

#include <zephyr/device.h>
#include <zephyr/drivers/sensor.h>
#include <zephyr/drivers/i2c.h>
#include <zephyr/drivers/gpio.h>
#include <zephyr/kernel.h>
#include <zephyr/devicetree.h>
#include <cmath>
#include <app-common/zap-generated/attributes/Accessors.h>
#include <zephyr/logging/log.h>

void mailbox_battery_init();
void mailbox_green_led_pulse();

LOG_MODULE_DECLARE(app, CONFIG_CHIP_APP_LOG_LEVEL);

using namespace ::chip;
using namespace ::chip::app;
using namespace ::chip::DeviceLayer;


// LSM6DS3TR-C wake-up interrupt via P0.02.
// Detectie wordt door de IMU uitgevoerd, niet door CPU-polling.

static const struct device *mailbox_imu =
    DEVICE_DT_GET(DT_ALIAS(imu0));

static const struct i2c_dt_spec mailbox_imu_i2c =
    I2C_DT_SPEC_GET(DT_ALIAS(imu0));

static const struct device *mailbox_gpio =
    DEVICE_DT_GET(DT_NODELABEL(gpio0));

constexpr gpio_pin_t MAILBOX_INT_PIN = 2;

static struct gpio_callback mailbox_gpio_callback;

static void mailbox_imu_irq_handler(struct k_work *work);
K_WORK_DEFINE(mailbox_irq_work, mailbox_imu_irq_handler);

static void mailbox_gpio_isr(const struct device *port,
                             struct gpio_callback *cb,
                             gpio_port_pins_t pins)
{
    ARG_UNUSED(port);
    ARG_UNUSED(cb);
    ARG_UNUSED(pins);

    k_work_submit(&mailbox_irq_work);
}

// Alarm actief tot 5 seconden na de laatste gedetecteerde schok.
static bool alarm_latched = false;
static void mailbox_alarm_timeout(struct k_work *work);

K_WORK_DELAYABLE_DEFINE(mailbox_alarm_timer, mailbox_alarm_timeout);

// Wordt uitgevoerd op de Matter-thread.
static void mailbox_matter_alarm_update(intptr_t context)
{
    const bool alarm = (context != 0);

    auto status =
        chip::app::Clusters::BooleanState::Attributes::StateValue::Set(
            1, alarm);

    if (status == chip::Protocols::InteractionModel::Status::Success) {
        LOG_INF("MAILBOX Matter endpoint 1 StateValue=%d", alarm ? 1 : 0);
    } else {
        LOG_ERR("MAILBOX Matter attribute update failed: %u",
                static_cast<unsigned>(status));
    }
}

// Wordt uitgevoerd na 5 seconden zonder nieuwe detectie.
static void mailbox_alarm_timeout(struct k_work *work)
{
    ARG_UNUSED(work);

    alarm_latched = false;
    LOG_INF("MAILBOX ALARM OFF: 5 seconds without detection");

    CHIP_ERROR err = PlatformMgr().ScheduleWork(
        mailbox_matter_alarm_update, 0);

    if (err != CHIP_NO_ERROR) {
        LOG_ERR("Failed to schedule Matter alarm reset: %"
                CHIP_ERROR_FORMAT, err.Format());
    }
}

static void mailbox_imu_irq_handler(struct k_work *work)
{
    ARG_UNUSED(work);

    // Lezen van WAKE_UP_SRC bevestigt een latched wake-up event.
    uint8_t source = 0;
    int rc = i2c_reg_read_byte_dt(&mailbox_imu_i2c, 0x1B, &source);

    if (rc != 0) {
        LOG_ERR("IMU WAKE_UP_SRC read failed: %d", rc);
        return;
    }

    // WU_IA = bit 3.
    if ((source & 0x08) == 0) {
        return;
    }

    // Korte LED-puls bij iedere bevestigde IMU-detectie.
    mailbox_green_led_pulse();

    // Iedere detectie verlengt het alarm met vijf seconden.
    k_work_reschedule(&mailbox_alarm_timer, K_SECONDS(5));

    if (!alarm_latched) {
        alarm_latched = true;
        LOG_INF("MAILBOX ALARM ON: IMU hardware wake-up");

        CHIP_ERROR err = PlatformMgr().ScheduleWork(
            mailbox_matter_alarm_update, 1);

        if (err != CHIP_NO_ERROR) {
            LOG_ERR("Failed to schedule Matter alarm: %"
                    CHIP_ERROR_FORMAT, err.Format());
        }
    } else {
        LOG_INF("MAILBOX ALARM retriggered");
    }
}

// Configureer de interne bewegingsdetectie van de LSM6DS3TR-C.
static int mailbox_imu_enable_interrupt()
{
    if (!device_is_ready(mailbox_imu) ||
        !i2c_is_ready_dt(&mailbox_imu_i2c) ||
        !device_is_ready(mailbox_gpio)) {
        return -ENODEV;
    }

    struct sensor_value odr = { .val1 = 52, .val2 = 0 };

    int rc = sensor_attr_set(
        mailbox_imu, SENSOR_CHAN_ACCEL_XYZ,
        SENSOR_ATTR_SAMPLING_FREQUENCY, &odr);

    if (rc != 0) {
        return rc;
    }

    // Disable INT1 wake-up routing during configuration.
    rc = i2c_reg_write_byte_dt(&mailbox_imu_i2c, 0x5E, 0x00);
    if (rc != 0) return rc;

    // TAP_CFG: interrupts enabled, slope filter, latched interrupt.
    rc = i2c_reg_write_byte_dt(&mailbox_imu_i2c, 0x58, 0x81);
    if (rc != 0) return rc;

    // WAKE_UP_DUR: geen extra detectieduur.
    rc = i2c_reg_write_byte_dt(&mailbox_imu_i2c, 0x5C, 0x00);
    if (rc != 0) return rc;

    // WAKE_UP_THS: één drempelstap bij +/-2g.
    rc = i2c_reg_write_byte_dt(&mailbox_imu_i2c, 0x5B, 0x01);
    if (rc != 0) return rc;

    rc = gpio_pin_configure(mailbox_gpio, MAILBOX_INT_PIN,
                            GPIO_INPUT);
    if (rc != 0) return rc;

    gpio_init_callback(&mailbox_gpio_callback, mailbox_gpio_isr,
                       BIT(MAILBOX_INT_PIN));

    rc = gpio_add_callback(mailbox_gpio, &mailbox_gpio_callback);
    if (rc != 0) return rc;

    // Oude wake-up status wissen.
    uint8_t source = 0;
    rc = i2c_reg_read_byte_dt(&mailbox_imu_i2c, 0x1B, &source);
    if (rc != 0) return rc;

    rc = gpio_pin_interrupt_configure(
        mailbox_gpio, MAILBOX_INT_PIN, GPIO_INT_EDGE_TO_ACTIVE);
    if (rc != 0) return rc;

    // MD1_CFG: route wake-up event naar INT1.
    rc = i2c_reg_write_byte_dt(&mailbox_imu_i2c, 0x5E, 0x20);
    if (rc != 0) return rc;

    LOG_INF("Mailbox IMU hardware interrupt enabled on P0.02");
    return 0;
}

CHIP_ERROR AppTask::Init()
{
	/* Initialize Matter stack */
	ReturnErrorOnFailure(Nrf::Matter::PrepareServer());

	if (!Nrf::GetBoard().Init()) {
		LOG_ERR("User interface initialization failed.");
		return CHIP_ERROR_INCORRECT_STATE;
	}

	/* Register Matter event handler that controls the connectivity status LED based on the captured Matter network
	 * state. */
	ReturnErrorOnFailure(Nrf::Matter::RegisterEventHandler(Nrf::Board::DefaultMatterEventHandler, 0));

	CHIP_ERROR err = Nrf::Matter::StartServer();
	if (err != CHIP_NO_ERROR) {
		return err;
	}

	mailbox_battery_init();

    // Synchroniseer de initiële alarmstatus met Matter.
    CHIP_ERROR alarm_err = PlatformMgr().ScheduleWork(
        mailbox_matter_alarm_update, 0);

    if (alarm_err != CHIP_NO_ERROR) {
        LOG_ERR("Failed to initialize Matter alarm: %"
                CHIP_ERROR_FORMAT, alarm_err.Format());
    }

    int imu_rc = mailbox_imu_enable_interrupt();

    if (imu_rc != 0) {
        LOG_ERR("Mailbox IMU interrupt configuration failed: %d",
                imu_rc);
    }


	return CHIP_NO_ERROR;
}

CHIP_ERROR AppTask::StartApp()
{
	ReturnErrorOnFailure(Init());

	while (true) {
		Nrf::DispatchNextTask();
	}

	return CHIP_NO_ERROR;
}
```

## src/battery_monitor.cpp
```c
#include <zephyr/drivers/gpio.h>
#include <zephyr/kernel.h>
#include <zephyr/device.h>
#include <zephyr/drivers/adc.h>
#include <zephyr/drivers/regulator.h>
#include <zephyr/logging/log.h>
#include <zephyr/sys/atomic.h>
#include <app-common/zap-generated/attributes/Accessors.h>
#include <platform/CHIPDeviceLayer.h>
#include <lib/core/CHIPError.h>

LOG_MODULE_REGISTER(mailbox_battery, LOG_LEVEL_INF);

// XIAO nRF54L15 green user LED, active-low on P2.00.
static const struct gpio_dt_spec mailbox_green_led =
    GPIO_DT_SPEC_GET(DT_ALIAS(led0), gpios);




// Groene LED: 100 ms puls per IMU-trigger.
// Nieuwe triggers tijdens een puls verlengen deze niet.
static atomic_t mailbox_led_active;
static bool mailbox_led_ready = false;

static void mailbox_led_off(struct k_work *work)
{
    ARG_UNUSED(work);

    if (mailbox_led_ready) {
        gpio_pin_set_dt(&mailbox_green_led, 0);
    }

    atomic_set(&mailbox_led_active, 0);
}

K_WORK_DELAYABLE_DEFINE(mailbox_led_timer, mailbox_led_off);

void mailbox_green_led_pulse()
{
    if (!mailbox_led_ready) {
        return;
    }

    // Alleen een nieuwe puls starten wanneer de LED uit is.
    if (!atomic_cas(&mailbox_led_active, 0, 1)) {
        return;
    }

    int rc = gpio_pin_set_dt(&mailbox_green_led, 1);
    if (rc != 0) {
        atomic_set(&mailbox_led_active, 0);
        LOG_WRN("Green LED ON failed: %d", rc);
        return;
    }

    k_work_schedule(&mailbox_led_timer, K_MSEC(100));
}

#define BATTERY_NODE DT_PATH(zephyr_user)

static const struct adc_dt_spec battery_adc =
    ADC_DT_SPEC_GET_BY_IDX(BATTERY_NODE, 0);

static const struct device *battery_regulator =
    DEVICE_DT_GET(DT_NODELABEL(vbat_pwr));


// Voorlopige LiPo-spanning-naar-percentage schatting.
// Alleen indicatief, vooral tijdens laden niet nauwkeurig.
struct BatteryPoint {
    uint16_t mv;
    uint8_t percent;
};

static uint8_t mailbox_battery_percent(uint32_t mv)
{
    static constexpr BatteryPoint curve[] = {
        {3300,   0},
        {3600,  10},
        {3700,  20},
        {3750,  30},
        {3800,  40},
        {3850,  50},
        {3900,  60},
        {3950,  70},
        {4000,  80},
        {4100,  90},
        {4200, 100},
    };

    if (mv <= curve[0].mv) {
        return 0;
    }

    for (size_t i = 1; i < sizeof(curve) / sizeof(curve[0]); ++i) {
        if (mv <= curve[i].mv) {
            const auto &a = curve[i - 1];
            const auto &b = curve[i];

            return a.percent +
                (mv - a.mv) * (b.percent - a.percent) /
                (b.mv - a.mv);
        }
    }

    return 100;
}

// Deze callback draait op de Matter-thread.
static void mailbox_matter_battery_update(intptr_t context)
{
    const uint32_t mv = static_cast<uint32_t>(context);
    const uint8_t percent = mailbox_battery_percent(mv);

    using namespace chip::app::Clusters::PowerSource::Attributes;
    using Status = chip::Protocols::InteractionModel::Status;

    const auto voltage_status = BatVoltage::Set(1, mv);

    // Matter gebruikt halve procenten: 200 = 100%.
    const auto percent_status =
        BatPercentRemaining::Set(
            1, static_cast<uint8_t>(percent * 2));

    if (voltage_status == Status::Success &&
        percent_status == Status::Success) {
        LOG_INF("MAILBOX Matter battery: %u mV, approx %u%%",
                static_cast<unsigned>(mv),
                static_cast<unsigned>(percent));
    } else {
        LOG_ERR("MAILBOX Matter battery update failed: voltage=%u percent=%u",
                static_cast<unsigned>(voltage_status),
                static_cast<unsigned>(percent_status));
    }
}

static void battery_measure(struct k_work *work);

K_WORK_DELAYABLE_DEFINE(battery_work, battery_measure);

static void battery_measure(struct k_work *work)
{
    ARG_UNUSED(work);

    int rc = regulator_enable(battery_regulator);

    if (rc != 0) {
        LOG_ERR("Battery measurement enable failed: %d", rc);
        goto next_measurement;
    }

    // De meetkring heeft een korte stabilisatietijd nodig.
    k_msleep(10);

    {
        int16_t raw = 0;
        struct adc_sequence sequence = {
            .buffer = &raw,
            .buffer_size = sizeof(raw),
        };

        rc = adc_sequence_init_dt(&battery_adc, &sequence);

        if (rc == 0) {
            rc = adc_read_dt(&battery_adc, &sequence);
        }

        if (rc == 0) {
            int32_t mv = raw;
            rc = adc_raw_to_millivolts_dt(&battery_adc, &mv);

            if (rc == 0) {
                int32_t battery_mv = mv * 2;
                LOG_INF("MAILBOX BATTERY: %d mV (%d.%03d V)",
                        battery_mv,
                        battery_mv / 1000,
                        battery_mv % 1000);

                // De ADC-meting doorgeven aan de Matter-thread.
                if (battery_mv >= 3000 && battery_mv <= 4300) {
                    CHIP_ERROR err =
                        chip::DeviceLayer::PlatformMgr().ScheduleWork(
                            mailbox_matter_battery_update,
                            static_cast<intptr_t>(battery_mv));

                    if (err != CHIP_NO_ERROR) {
                        LOG_ERR("Failed to schedule Matter battery update");
                    }
                } else {
                    LOG_WRN("Battery voltage outside expected range: %d mV",
                            battery_mv);
                }
            }
        }

        if (rc != 0) {
            LOG_ERR("Battery ADC measurement failed: %d", rc);
        }
    }

    rc = regulator_disable(battery_regulator);

    if (rc != 0) {
        LOG_ERR("Battery measurement disable failed: %d", rc);
    }

next_measurement:
    k_work_reschedule(&battery_work, K_HOURS(1));
}

void mailbox_battery_init()
{
    // Keep the green user LED off to save battery power.
    if (gpio_is_ready_dt(&mailbox_green_led)) {
        int led_rc = gpio_pin_configure_dt(
            &mailbox_green_led, GPIO_OUTPUT_INACTIVE);
        if (led_rc != 0) {
            LOG_WRN("Green LED disable failed: %d", led_rc);
        }
        mailbox_led_ready = (led_rc == 0);
    }

    if (!adc_is_ready_dt(&battery_adc) ||
        !device_is_ready(battery_regulator)) {
        LOG_ERR("Battery ADC or regulator not ready");
        return;
    }

    int rc = adc_channel_setup_dt(&battery_adc);

    if (rc != 0) {
        LOG_ERR("Battery ADC channel setup failed: %d", rc);
        return;
    }

    LOG_INF("Battery monitoring initialized (1 hour interval)");
    k_work_schedule(&battery_work, K_SECONDS(3));
}
```
